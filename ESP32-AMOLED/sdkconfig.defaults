## ESP32-AMOLED/sdkconfig.defaults
```kconfig
CONFIG_IDF_TARGET="esp32s3"
CONFIG_ESPTOOLPY_FLASHSIZE_16MB=y
CONFIG_SPIRAM=y
CONFIG_SPIRAM_MODE_OCT=y
CONFIG_ESP_CONSOLE_USB_CDC=y
CONFIG_LV_COLOR_DEPTH_16=y
CONFIG_FREERTOS_HZ=1000

# WiFi
CONFIG_ESP_WIFI_STATIC_RX_BUFFER_NUM=10
CONFIG_ESP_WIFI_DYNAMIC_RX_BUFFER_NUM=32
CONFIG_ESP_WIFI_DYNAMIC_TX_BUFFER=y
CONFIG_ESP_WIFI_AMPDU_TX_ENABLED=y
CONFIG_ESP_WIFI_AMPDU_RX_ENABLED=y
CONFIG_ESP_WIFI_NVS_ENABLED=y
CONFIG_ESP_WIFI_SOFTAP_SUPPORT=y

# LVGL fonts
CONFIG_LV_FONT_MONTSERRAT_14=y
CONFIG_LV_FONT_MONTSERRAT_16=y
CONFIG_LV_FONT_MONTSERRAT_28=y

# SNTP
CONFIG_LWIP_SNTP_MAX_SERVERS=3
CONFIG_PARTITION_TABLE_CUSTOM_FILENAME="partitions.csv"
CONFIG_PARTITION_TABLE_SINGLE_APP_LARGE=y
```

## main/Kconfig.projbuild
```kconfig
menu "ESP32-AMOLED Configuration"

config BOARD_LCD_WIDTH
    int "LCD width"
    default 368

config BOARD_LCD_HEIGHT
    int "LCD height"
    default 448

config BOARD_LCD_SPI_FREQ_MHZ
    int "LCD SPI frequency (MHz)"
    default 40

config BOARD_LCD_BRIGHTNESS_DEFAULT
    int "Default LCD brightness (0-255)"
    default 128

config BOARD_I2C_MASTER_PORT
    int "I2C master port number"
    default 0

config BOARD_I2C_SDA
    int "I2C SDA GPIO"
    default 15

config BOARD_I2C_SCL
    int "I2C SCL GPIO"
    default 14

config BOARD_I2C_FREQ_HZ
    int "I2C frequency (Hz)"
    default 400000

config BOARD_LCD_CS
    int "LCD CS GPIO"
    default 12

config BOARD_LCD_SCLK
    int "LCD SCLK GPIO"
    default 11

config BOARD_LCD_SDIO0
    int "LCD SDIO0 GPIO"
    default 4

config BOARD_LCD_SDIO1
    int "LCD SDIO1 GPIO"
    default 5

config BOARD_LCD_SDIO2
    int "LCD SDIO2 GPIO"
    default 6

config BOARD_LCD_SDIO3
    int "LCD SDIO3 GPIO"
    default 7

config BOARD_TOUCH_INT
    int "Touch INT GPIO"
    default 21

config BOARD_I2S_MCK
    int "I2S MCK GPIO"
    default 16

config BOARD_I2S_BCK
    int "I2S BCK GPIO"
    default 9

config BOARD_I2S_WS
    int "I2S WS GPIO"
    default 45

config BOARD_I2S_DO
    int "I2S DO GPIO"
    default 10

config BOARD_I2S_DI
    int "I2S DI GPIO"
    default 8

config BOARD_PA_EN
    int "Power Amplifier Enable GPIO"
    default 46

endmenu
```

## sdkconfig.defaults
```kconfig
# ESP32-S3-Touch-AMOLED-1.8 Configuration
CONFIG_IDF_TARGET="esp32s3"
CONFIG_ESPTOOLPY_FLASHMODE_QIO=y
CONFIG_ESPTOOLPY_FLASHSIZE_16MB=y
CONFIG_PARTITION_TABLE_CUSTOM=y
CONFIG_COMPILER_OPTIMIZATION_PERF=y
CONFIG_SPIRAM=y
CONFIG_SPIRAM_MODE_OCT=y
CONFIG_SPIRAM_FETCH_INSTRUCTIONS=y
CONFIG_SPIRAM_RODATA=y
CONFIG_SPIRAM_SPEED_80M=y
CONFIG_ESP_DEFAULT_CPU_FREQ_MHZ_240=y
CONFIG_ESP32S3_DATA_CACHE_LINE_64B=y
CONFIG_FREERTOS_HZ=1000

# LVGL Configuration
CONFIG_LV_DISP_DEF_REFR_PERIOD=16
CONFIG_LV_INDEV_DEF_READ_PERIOD=16
CONFIG_LV_COLOR_16_SWAP=y
CONFIG_LV_COLOR_SCREEN_TRANSP=y
CONFIG_LV_MEM_CUSTOM=y
CONFIG_LV_MEM_SIZE=0x8000
CONFIG_LV_MEMCPY_MEMSET_STD=y
CONFIG_LV_USE_PERF_MONITOR=n
CONFIG_LV_USE_MEM_MONITOR=n
CONFIG_LV_ATTRIBUTE_FAST_MEM_USE_IRAM=y

# LVGL Fonts
CONFIG_LV_FONT_MONTSERRAT_12=y
CONFIG_LV_FONT_MONTSERRAT_14=y
CONFIG_LV_FONT_MONTSERRAT_16=y
CONFIG_LV_FONT_MONTSERRAT_18=y
CONFIG_LV_FONT_MONTSERRAT_20=y
CONFIG_LV_FONT_MONTSERRAT_24=y
CONFIG_LV_FONT_MONTSERRAT_28=y
CONFIG_LV_FONT_MONTSERRAT_32=y
CONFIG_LV_FONT_MONTSERRAT_36=y
CONFIG_LV_FONT_MONTSERRAT_40=y
CONFIG_LV_FONT_MONTSERRAT_48=y

# LVGL Demos (disabled for production)
CONFIG_LV_USE_DEMO_WIDGETS=n
CONFIG_LV_USE_DEMO_BENCHMARK=n
CONFIG_LV_USE_DEMO_STRESS=n
CONFIG_LV_USE_DEMO_MUSIC=n

# Disable Arduino dependency for LVGL tick
CONFIG_LV_TICK_CUSTOM=n
```
